		AREA Init, CODE, READONLY 
		ENTRY                    
		LDR R0,=0521632478		
		LDR R1,=0X40000000		     
		LDR R2,=0X40000010		  
		MOV R7,#10 				
M1		BL DIV10				    
		STRB R5,[R1],#1
		MOV R0,R6
		SUBS R7,R7,#1
		BNE M1
		B TEND
DIV10	MOV R3,R0			
		MOV R4,#32			
		MOV R5,#0			
		MOV R6,#0			
DIV2	MOV R6,R6,LSL #1	
		MOV R5,R5,LSL #1	
		MOVS R3,R3, LSL #1	
		ADC R5,R5,#0		              
		SUBS R5,R5,#10	
		ADDCS  R6,R6,#1	 
		ADDCC R5,R5,#10	   
							
		SUBS R4,R4,#1		  
		BNE  DIV2
		BX LR				
TEND	LDR R3,=BCDCODE		
		LDR R4,=0X40000000		
		LDR R5,=0X40000010		  
		MOV R6,#10				
TEND1	LDRB R7,[R4],#1
		LDRB R8,[R3,R7]
		STRB R8,[R5],#1
		SUBS R6,R6,#1
		BNE  TEND1
		MOV R0,R0
		
BCDCODE DCB 0X3F,0X06,0X5B,0X4F,0X66,0X6D,0X7D,0X7F,0X6F,0X00,0X00,0X00
        END  
